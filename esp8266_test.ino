// -- -- -- -- -- -- -- -- -- -- -- -- -- -- -- -- -- -- -- -- -- -- -- -- -- -- -- -- -- -- -- -- -- -- --
// ------------------------------------------------------------------------------------------------- module
// -- -- -- -- -- -- -- -- -- -- -- -- -- -- -- -- -- -- -- -- -- -- -- -- -- -- -- -- -- -- -- -- -- -- --
// --                                                                                                    --
// --                                                                                                    --
// --             "esp8266_test"                                                                         --
// --                                                                                                    --
// --                                                                                                    --
// -- -- -- -- -- -- -- -- -- -- -- -- -- -- -- -- -- -- -- -- -- -- -- -- -- -- -- -- -- -- -- -- -- -- --
// ---------------------------------------------------------------------------------------------- component
// -- -- -- -- -- -- -- -- -- -- -- -- -- -- -- -- -- -- -- -- -- -- -- -- -- -- -- -- -- -- -- -- -- -- --
// --                                                                                                    --
// --                                                                                                    --
// -- title       : esp8266_test                                                                         --
// -- design      : esp8266_test                                                                         --
// -- version     : 1.0                                                                                  --
// -- author      : goldobin a.                                                                          --
// -- company     : cardboard.ru                                                                         --
// -- data        : 06/09/2022                                                                           --
// --                                                                                                    --
// --                                                                                                    --
// -- description :                                                                                      --
// --                                                                                                    --
// --                                                                                                    --
// --             (1) СИГНАЛИЗАЦИЯ используется единственный светодиод                                   --
// --                 LED_BUILTIN    - встроенный светодиод                                              --
// --                                                                                                    --
// --             (2) КОНТАКТЫ используются для имитации нажатия кнопки                                  --
// --                 14 (D1, GPIO5) - в режиме OUTPUT                                                   --
// --                 13 (D2, GPIO4) - в режиме INPUT                                                    --
// --                                                                                                    --
// --             (3) ФУНКЦИИ исполняются в зависимости от настройки макроопределения #define            --
// --                 TEST 1 : blink3 - тест управления встроенным светодиодом                           --
// --                 TEST 2 : blink2 - тест управления встроенным светодиодом                           --
// --                 TEST 3 : keypress - тест имитации нажатия кнопки                                   --
// --                 TEST 4 : scan - тест модуля wifi                                                   --
// --                 TEST 5 : scan+keypess+blink2+blink3 - комплексный тест                             --
// --                                                                                                    --
// --             (3) МЕТОДЫ вызываются из сопряжённых с проектом библиотек                              --
// --                 начальная настройка модуля UART                               Serial.begin         --
// --                 вывод строки в UART                                           Serial.println       --
// --                 вывод символов в UART                                         Serial.print         --
// --                 начальная настройка модуля WIFI                               WiFi.mode            --
// --                 отключение модуля WIFI                                        WiFi.disconnect      --
// --                 поиск активных точек подключения WIFI                         WiFi.scanNetworks    --

// -- -- -- -- -- -- -- -- -- -- -- -- -- -- -- -- -- -- -- -- -- -- -- -- -- -- -- -- -- -- -- -- -- -- --
// --------------------------------------------------------------------------------------------------------
// -- -- -- -- -- -- -- -- -- -- -- -- -- -- -- -- -- -- -- -- -- -- -- -- -- -- -- -- -- -- -- -- -- -- --


///////////////////////////////////////////////////////////////////////////////
// ----------------------------------------------------------------------------
//                                       НАСТРОЙКИ ПРОЦЕССОВ, МЕТОДОВ И ФУНКЦИЙ
// глобальные определения
// ----------------------------------------------------------------------------
///////////////////////////////////////////////////////////////////////////////

#include "ESP8266WiFi.h"

#define TEST 1                                                                  // ТЕСТ 1 : blink3 - тест управления встроенным светодиодом
// #define TEST 2                                                               // ТЕСТ 2 : blink2 - тест управления встроенным светодиодом
// #define TEST 3                                                               // ТЕСТ 3 : keypress - тест имитации нажатия кнопки
// #define TEST 4                                                               // ТЕСТ 4 : scan - тест модуля wifi
// #define TEST 5                                                               // ТЕСТ 5 : scan+keypess+blink2+blink3 - комплексный тест


///////////////////////////////////////////////////////////////////////////////
// ----------------------------------------------------------------------------
//                                                              ФУНКЦИЯ-ПРОЦЕСС
// начальная настройка                                                    setup
// ----------------------------------------------------------------------------
///////////////////////////////////////////////////////////////////////////////


void setup()

{

  Serial.begin (9600) ;                                                         // МЕТОД Serial.begin : скорость 9600 бод

  WiFi.mode (WIFI_STA) ;                                                        // МЕТОД WiFi.mode : режим WIFI_STA (station mode)

  WiFi.disconnect () ;                                                          // МЕТОД WiFi.disconnect : для случая если модуль был включён

  // --------------------------------------------------------------------------
  // начальная настройка контактов
  // --------------------------------------------------------------------------

  pinMode (LED_BUILTIN, OUTPUT) ;                                               // контакт LED_BUILTIN в режим OUTPUT
  pinMode (14, OUTPUT) ;                                                        // контакт 14 (D1, GPIO5) в режим OUTPUT
  pinMode (13, INPUT) ;                                                         // контакт 13 (D2, GPIO4) в режим INPUT

  delay (100) ;                                                                 // пауза 100 мсек

  Serial.println ("setup done") ;                                               // МЕТОД Serial.println

}


///////////////////////////////////////////////////////////////////////////////
// ----------------------------------------------------------------------------
//                                                              ФУНКЦИЯ-ПРОЦЕСС
// бесконечное исполнение                                                  loop
// ----------------------------------------------------------------------------
///////////////////////////////////////////////////////////////////////////////


void loop()


{

  switch ( TEST )

  {

    case 1 :

      // ----------------------------------------------------------------------
      // тест управления встроенным светодиодом
      // встроенный светодиод однократно мигает 3 раза 20 мс с интервалом 300 мс
      // ----------------------------------------------------------------------

      blink3 () ;                                                               // ВЫЗОВ ФУНКЦИИ blink3

      break ;


    case 2 :

      // ----------------------------------------------------------------------
      // тест управления встроенным светодиодом
      // встроенный светодиод однократно мигает 2 раза 500 мс с интервалом 500 мс
      // ----------------------------------------------------------------------

      blink2 () ;                                                               // ВЫЗОВ ФУНКЦИИ blink2

      break ;


    case 3 :

      // ----------------------------------------------------------------------
      // тест имитации нажатия кнопки (ВЫЗОВ blink2, blink3)
      // используются контакты
      //                       14 (D1, GPIO5) в режиме OUTPUT
      //                       13 (D2, GPIO4) в режиме INPUT
      // ----------------------------------------------------------------------

      keypress () ;                                                             // ВЫЗОВ ФУНКЦИИ keypress

      break ;


    case 4 :

      // ----------------------------------------------------------------------
      // тест сканер сетей WIFI
      // вывод в модуль UART сведений об активных точках подключения WIFI
      // ----------------------------------------------------------------------

      scan () ;                                                                 // ВЫЗОВ ФУНКЦИИ scan

      break ;


    default :

      // ----------------------------------------------------------------------
      // комплексный тест
      // scan : тест модуля WIFI
      // keypress : тест имитации нажатия кнопки (ВЫЗОВ blink2, blink3)
      // ----------------------------------------------------------------------

      scan () ;                                                                 // ВЫЗОВ ФУНКЦИИ scan

      for ( ; ; )

        keypress () ;                                                           // ВЫЗОВ ФУНКЦИИ keypress

  }

}


///////////////////////////////////////////////////////////////////////////////
// ----------------------------------------------------------------------------
//                                                                      ФУНКЦИЯ
// встроенный светодиод мигает 3 раза 20 мс с интервалом 300 мс          blink3
// ----------------------------------------------------------------------------
///////////////////////////////////////////////////////////////////////////////


void blink3 ()


{

  int i ;

  for ( i = 0 ;
        i < 3 ;
        i++ )
  {

    digitalWrite (LED_BUILTIN, HIGH) ;                                          // свечение LED_BUILTIN в режиме HIGH

    delay (20) ;                                                                // пауза 20 мсек

    digitalWrite (LED_BUILTIN, LOW) ;                                           // свечение LED_BUILTIN в режиме LOW

    delay (300) ;                                                               // пауза 300 мсек

  }

}


///////////////////////////////////////////////////////////////////////////////
// ----------------------------------------------------------------------------
//                                                                      ФУНКЦИЯ
// встроенный светодиод мигает 2 раза 500 мс с интервалом 500 мс         blink2
// ----------------------------------------------------------------------------
///////////////////////////////////////////////////////////////////////////////


void blink2 ()

{

  int i ;

  for ( i = 0 ;
        i < 2 ;
        i++ )
  {

    digitalWrite (LED_BUILTIN, HIGH) ;                                          // свечение LED_BUILTIN в режиме HIGH

    delay (500) ;                                                               // пауза 500 мсек

    digitalWrite (LED_BUILTIN, LOW) ;                                           // свечение LED_BUILTIN в режиме LOW

    delay (500) ;                                                               // пауза 500 мсек

  }

}


///////////////////////////////////////////////////////////////////////////////
// ----------------------------------------------------------------------------
//                                                                      ФУНКЦИЯ
// имитация нажатия кнопки                                             keypress
// ----------------------------------------------------------------------------
///////////////////////////////////////////////////////////////////////////////


void keypress ()

{

  boolean button ;

  digitalWrite (14, HIGH) ;                                                     // контакт 14 в режиме HIGH

  button = digitalRead (13) ;                                                   // проверка состояния кнопки

  if (button)

    blink2 () ;                                                                 // ВЫЗОВ ФУНКЦИИ blink2

  else

    blink3 () ;                                                                 // ВЫЗОВ ФУНКЦИИ blink3

}

///////////////////////////////////////////////////////////////////////////////
// ----------------------------------------------------------------------------
//                                                                      ФУНКЦИЯ
// сбор сведений об активных точках подключения WIFI                       scan
// ----------------------------------------------------------------------------
///////////////////////////////////////////////////////////////////////////////


void scan ()

{

  int i ;

  int n ;

  // --------------------------------------------------------------------------
  // возвращает число активных точек подключения WIFI         WiFi.scanNetworks
  // --------------------------------------------------------------------------

  n = WiFi.scanNetworks () ;                                                    // МЕТОД WiFi.scanNetworks

  if (n == 0)

    Serial.println ("no networks found") ;                                      // МЕТОД Serial.println

  else

  {


    Serial.print (n) ;                                                          // МЕТОД Serial.print : число обнаруженных сетей WIFI

    Serial.println (" networks found") ;                                        // МЕТОД Serial.println


    for (
      i = 0 ;
      i < n ;
      ++i
    )

    {

      Serial.print (i + 1) ;                                                    // МЕТОД Serial.print : номер в списке

      Serial.print (" : ") ;                                                    // МЕТОД Serial.print

      Serial.print (WiFi.SSID(i)) ;                                             // МЕТОД Serial.print : значение i-ого WiFi.SSID

      Serial.print (" (") ;                                                     // МЕТОД Serial.print

      Serial.print (WiFi.RSSI(i)) ;                                             // МЕТОД Serial.print : значение i-ого WiFi.RSSI

      Serial.println (")") ;                                                    // МЕТОД Serial.print


      delay (10) ;                                                              // пауза 10 мсек

    }
  }


  Serial.println ("") ;                                                         // МЕТОД Serial.println


  delay (5000) ;                                                                // пауза 5 сек

}
